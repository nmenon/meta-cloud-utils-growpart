## meta-cloud-utils-growpart/conf/layer.conf
```bitbake
BBPATH .= ":${LAYERDIR}"
BBFILES += "${LAYERDIR}/recipes-*/*/*.bb \
            ${LAYERDIR}/recipes-*/*/*.bbappend"

BBFILE_COLLECTIONS += "cloudutilsgrowpart"
BBFILE_PATTERN_cloudutilsgrowpart = "^${LAYERDIR}/"
BBFILE_PRIORITY_cloudutilsgrowpart = "6"

LAYERSERIES_COMPAT_cloudutilsgrowpart = "master wrynose whinlatter styhead"
```
